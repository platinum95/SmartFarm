## CMakeLists.txt
```
cmake_minimum_required(VERSION 3.12)

include($ENV{ZEPHYR_BASE}/cmake/app/boilerplate.cmake NO_POLICY_SCOPE)
list(APPEND CMAKE_CXX_FLAGS
      -fpermissive
)

project(NONE)

FILE(GLOB app_sources src/*.c*)
target_sources(app PRIVATE ${app_sources})
```

## prj.conf
```kconfig
CONFIG_GPIO=y
CONFIG_ADC=y
CONFIG_ADC_NRFX_SAADC=y
CONFIG_ADC_ASYNC=y
CONFIG_ADC_0=y
CONFIG_LOG=y
CONFIG_LOG_BACKEND_RTT_MODE_DROP=y
CONFIG_ADC_LOG_LEVEL_INF=y
CONFIG_SERIAL=n
CONFIG_PRINTK=y
#CONFIG_BT=y
#CONFIG_USE_SEGGER_RTT=y
CONFIG_RTT_CONSOLE=y
CONFIG_USE_SEGGER_RTT=y
CONFIG_BT=y
CONFIG_CPLUSPLUS=y
CONFIG_SENSOR=y
CONFIG_DHT=y
CONFIG_DHT_CHIP_DHT11=y
CONFIG_DHT_NAME="DHT11"
CONFIG_DHT_GPIO_DEV_NAME="GPIO_0"
CONFIG_DHT_GPIO_PIN_NUM=25


CONFIG_INIT_STACKS=y
CONFIG_NETWORKING=y

CONFIG_NET_L2_BT=y
# Include the following if communicating with a Linux kernel version < 4.12
CONFIG_NET_L2_BT_SEC_LEVEL=1

CONFIG_NET_IPV4=n
CONFIG_NET_IPV6=y
CONFIG_NET_TCP=y
CONFIG_NET_UDP=y
CONFIG_NET_ARP=y
CONFIG_NET_IPV6_RA_RDNSS=y
CONFIG_NET_IPV6_MAX_NEIGHBORS=6
CONFIG_NET_MAX_CONTEXTS=5
#CONFIG_NET_LOG=y
CONFIG_NET_SHELL=y

CONFIG_NET_PKT_RX_COUNT=16
CONFIG_NET_PKT_TX_COUNT=16

CONFIG_NET_BUF_DATA_SIZE=256
CONFIG_NET_BUF_RX_COUNT=15
CONFIG_NET_BUF_TX_COUNT=15

CONFIG_NET_IF_UNICAST_IPV6_ADDR_COUNT=3
CONFIG_NET_IF_MCAST_IPV6_ADDR_COUNT=5

CONFIG_NET_CONFIG_SETTINGS=y
CONFIG_NET_CONFIG_PEER_IPV6_ADDR="fd00:b::1"
CONFIG_NET_CONFIG_BT_NODE=y

CONFIG_MQTT_LIB=y
CONFIG_JSON_LIBRARY=y

CONFIG_MAIN_STACK_SIZE=2048

CONFIG_ENTROPY_GENERATOR=y
CONFIG_TEST_RANDOM_GENERATOR=y
CONFIG_TIMER_RANDOM_GENERATOR=y

CONFIG_BT_SIGNING=y
CONFIG_BT_RX_STACK_SIZE=1024
CONFIG_BT_DEVICE_NAME="Zephyr_Team06"
# App may not fit in RAM with ECC enabled
CONFIG_BT_TINYCRYPT_ECC=n
CONFIG_BT_L2CAP_TX_BUF_COUNT=3
CONFIG_BT_L2CAP_TX_MTU=65
CONFIG_BT_L2CAP_DYNAMIC_CHANNEL=y
CONFIG_BT_HCI_TX_STACK_SIZE=640
CONFIG_BT_HCI_HOST=y
CONFIG_BT_HCI_CMD_COUNT=2
CONFIG_BT_RX_BUF_COUNT=20
# Test lower value to save RAM (orig 1024)
CONFIG_BT_RX_BUF_LEN=512
CONFIG_BT_RECV_IS_RX_THREAD=y
CONFIG_BT_DEBUG=y
# CONFIG_BT_DEBUG_LOG=y
CONFIG_BT_MAX_CONN=3
# CONFIG_BT_DEBUG_RPA=y
# CONFIG_BT_DEBUG_HCI_DRIVER=y
# CONFIG_BT_DEBUG_HCI_CORE=y
# CONFIG_BT_DEBUG_CONN=y

CONFIG_PWM=y
CONFIG_PWM_NRF5_SW_0_CLOCK_PRESCALER=9
```

## src/main.c
```c
/*
 * Copyright (c) 2017 Intel Corporation
 *
 * SPDX-License-Identifier: Apache-2.0
 */

 #define LOG_MODULE_NAME net_tb_device
 #define NET_LOG_LEVEL LOG_LEVEL_DBG

#include <zephyr.h>

#include <net/net_context.h>

#include <misc/printk.h>
#include <string.h>
#include <stdio.h>
#include <errno.h>

#if defined(CONFIG_NET_L2_BT)
#include <bluetooth/bluetooth.h>
#include <bluetooth/conn.h>
#endif

#include "tb_pubsub.h"
#include "sensors.h"
#include "config.h"
#include "lights.h"

#define ATTR_UPDATE_INTERVAL 15

#define RC_STR(rc)	((rc) == 0 ? "OK" : "ERROR")
#define PRINT_RESULT(func, rc)	\
	printf("[%s:%d] %s: %d <%s>\n", __func__, __LINE__, \
	       (func), rc, RC_STR(rc))

static void update_attributes()
{
	static char payload[128];

	/* Formulate the JSON payload for the attribute update */
	snprintf(payload, sizeof(payload), "{\"firmware_version\":\"%s\", \"serial_number\":\"%s\", \"uptime\":\"%d\"}",
		"1.2.3",
		"andersm001",
		(uint32_t)k_uptime_get_32() / 1000);

	tb_publish_attributes(payload);
}

#if defined(CONFIG_NET_L2_BT)
static bool bt_connected;

static
void bt_connect_cb(struct bt_conn *conn, u8_t err)
{
	bt_connected = true;
}

static
void bt_disconnect_cb(struct bt_conn *conn, u8_t reason)
{
	bt_connected = false;
	printf("bt disconnected (reason %u)\n", reason);
}

static
struct bt_conn_cb bt_conn_cb = {
	.connected = bt_connect_cb,
	.disconnected = bt_disconnect_cb,
};
#endif

static int network_setup(void)
{

#if defined(CONFIG_NET_L2_BT)
	const char *progress_mark = "/-\\|";
	int i = 0;
	int rc;

	rc = bt_enable(NULL);
	if (rc && rc != -EALREADY) {
		printf("bluetooth init failed\n");
		return rc;
	}

	bt_conn_cb_register(&bt_conn_cb);

	printf("\nwaiting for bt connection: ");
	while (bt_connected == false) {
		k_sleep(250);
		printf("%c\b", progress_mark[i]);
		i = (i + 1) % (sizeof(progress_mark) - 1);
	}
	printf("\n");
#endif

	return 0;
}

// void attribute_work_handler(struct k_work *work)
// {
//   printf("Updating Attributes\n");
//   update_attributes();
//   sensors();
// }
//
// K_WORK_DEFINE(attribute_work, attribute_work_handler);
//
// void attribute_timer_handler(struct k_timer *attribute_timer)
// {
// 	k_work_submit(&attribute_work);
// }

void main(void)
{
	int rc;
	rc = network_setup();
	PRINT_RESULT("network_setup", rc);
	if (rc < 0) {
		return;
	}

  tb_pubsub_start();

  //struct k_timer attribute_timer;
  //k_timer_init(&attribute_timer, attribute_timer_handler, NULL);
  //k_timer_start(&attribute_timer, K_SECONDS(ATTR_UPDATE_INTERVAL), K_SECONDS(ATTR_UPDATE_INTERVAL));
  struct device *dev = device_get_binding("DHT11");

  while (1) {
    update_attributes();
    k_sleep(10000);
    sensors(dev);
  }
  //k_thread_suspend(k_current_get());
}
```

## src/main.cpp
```c
/*
 * Copyright (c) 2017 Intel Corporation
 *
 * SPDX-License-Identifier: Apache-2.0
 */

// #define LOG_MODULE_NAME net_tb_device
// #define NET_LOG_LEVEL LOG_LEVEL_DBG

#include <zephyr.h>
#include <board.h>
#include <device.h>

#include <string.h>
#include <stdio.h>

#include "tb_pubsub.h"
#include "btHelper.h"
#include "config.h"
#include "devConf.h"
#include <type_traits>
#include <pwm.h>

// RPC callback for updating overall device settings.
// Common between all devices for easier remote configuration.
// Not yet implemented.
char * updateSettings( char* json, int jsonLen ){
    printf( "Updating settings...\n" );
    return 0;
}

RPCB( settingsRpc, updateSettings, updateSettings );

// Retrieve payloads from all configured sensors. Concatentate
// and send the data to the MQTT broker.
void sensorWorker() {
    static char jsonBuff[ 142 ];
    jsonBuff[ 0 ] = 0;
    snprintf( jsonBuff, 142, "{" );
    for( auto sensor : sensors ){
        if( const char * sensorPayload = sensor->requestPayload() ){
            snprintf( jsonBuff + strlen( jsonBuff ), 
                      142, "%s,", sensorPayload );
        }
    }
    if( strlen( jsonBuff ) < 2 ){
        return;    // Abort if some error has occurred
    }
    // Remove final separator
    jsonBuff[ strlen( jsonBuff ) - 1 ] = 0;
    snprintf( jsonBuff + strlen( jsonBuff ), 142, "}" );
    tb_publish_telemetry( jsonBuff );
    printf( "telemetry published: %s\n", jsonBuff );
}

// Send attribute update to MQTT/TB
void attributeWorker(){
    static char payload[ 128 ];

    /* Formulate the JSON payload for the attribute update */
    snprintf( payload, sizeof(payload), 
        "{\"firmware_version\":\"%s\", \"serial_number\":\"%s\", \"uptime\":\"%d\"}",
        "1.2.3",
        "andersm001",
        (uint32_t)k_uptime_get_32() / 1000 );

    tb_publish_attributes( payload );
    printf( "Attribs published: %s\n", payload );
}

// The work task that updates TB
void interWorker( struct k_work *work ){
    attributeWorker();
    sensorWorker();
}


K_WORK_DEFINE( interWork, interWorker );
// The timer event that queues the work task
void interEvent( struct k_timer *attribute_timer ){
    k_work_submit( &interWork );
}

void main(void){
    // Initialise all sensors and lights for this device
    lights_init();
    for( auto sensor : sensors )
        sensor->initialise();

    // Start BT connection
    int rc = networkSetup();
    printf( "Network setup - %i\n", rc );
    if (rc < 0) {
        return;
    }

    // Get number of RPC callbacks
    int rpcLen = std::extent< decltype( rpcList ) >::value;
    // Start the TB thread, pass along RPC callbacks
    tb_pubsub_start( rpcList, rpcLen );

    // Start the attrib/telemetry timer event
    struct k_timer interTimer;
    k_timer_init( &interTimer, interEvent, NULL );
    k_timer_start( &interTimer, K_SECONDS( 5 ), K_SECONDS( 5 ) );

    // Suspend the main thread
    k_thread_suspend( k_current_get() );

}
```

## src/RpcBase.h
```c
#ifndef RPCBASE_H
#define RPCBASE_H

// Base struct representing an RPC type
typedef struct RpCallback {
    char * ( *callback )( char*, int );
    const char * name; 
} RpCallback;

#define RPCB( _name, _func, _cbName ) \
            RpCallback _name = {  \
                .callback = &_func, \
                .name = #_cbName \
            }

#endif
```

## src/RpcConf.c
```c
#include <zephyr.h>
#include <board.h>
#include <device.h>
#include <gpio.h>
#include "RpcConf.h"
#include <json.h>
#include <pwm.h>
#include <nrfx_pwm.h>

#define PWM_DEV CONFIG_PWM_NRF5_SW_0_DEV_NAME

/*
 * Unlike pulse width, period is not a critical parameter for
 * motor control. 20ms is commonly used.
 */
#define PERIOD 25000//(USEC_PER_SEC / 50) * 100

/* all in micro second */
#define STEPSIZE 100
#define MINPULSEWIDTH 700
#define MAXPULSEWIDTH 2300

#define SERVO_PIN 13

#define LED_PORT LED0_GPIO_CONTROLLER
#define LED_COUNT 4

const u32_t led_arr[LED_COUNT] = {
    LED0_GPIO_PIN,
    LED1_GPIO_PIN,
    LED2_GPIO_PIN,
    LED3_GPIO_PIN
};

struct rpc_putLights {
	const char* method;
	struct rpc_putLights_params {
		int ledno;
		bool value;
	} params;
};

struct rpc_setServo {
	const char* method;
	struct rpc_setServo_params {
		int value;
	} params;
};


// RPC callback for setting the servo to ON or OFF
char * setServo( char * json, int jsonLen ){
    /* Refer to zephyr/include/json.h !!! */
    struct device *pwm_dev = device_get_binding( PWM_DEV );
	if (!pwm_dev) {
		printf("Cannot find PWM device!\n");
		return NULL;
	}

	/* JSON RPC params for setServo */
	static const struct json_obj_descr rpc_descr_params[] = {
		JSON_OBJ_DESCR_PRIM(struct rpc_setServo_params, value, JSON_TOK_NUMBER),
	};

	/* JSON generic thingsboard.io RPC */
	static const struct json_obj_descr rpc_descr[] = {
		JSON_OBJ_DESCR_PRIM(struct rpc_setServo, method, JSON_TOK_STRING),
		JSON_OBJ_DESCR_OBJECT(struct rpc_setServo, params, rpc_descr_params)
	};

	struct rpc_setServo rx_rpc={};
    
    json_obj_parse(json, jsonLen, rpc_descr, ARRAY_SIZE(rpc_descr), &rx_rpc);

    int pulseWidth = rx_rpc.params.value;
    printf("Got value %i\n", pulseWidth );
    if ( pulseWidth < MINPULSEWIDTH )
        pulseWidth = MINPULSEWIDTH;
    else if ( pulseWidth > MAXPULSEWIDTH )
        pulseWidth = MAXPULSEWIDTH;
    printf("Setting PWM to %i %i\n", PERIOD, pulseWidth );
    if ( pwm_pin_set_usec( pwm_dev, 13, PERIOD, pulseWidth ) ) {
			printf( "Failed to set PWM\n" );
	}

	// No response
	return NULL;
}

struct device *led_dev;

uint8_t ledState[4] = { 0, 0, 0 };

// RPC callback for setting one of the LEDs on
char * putLights( char * json, int jsonLen ){
    /* Refer to zephyr/include/json.h !!! */
    static char * payload[ 50 ];

	/* JSON RPC params for putLights */
	static const struct json_obj_descr rpc_descr_params[] = {
		JSON_OBJ_DESCR_PRIM(struct rpc_putLights_params, ledno, JSON_TOK_NUMBER),
		JSON_OBJ_DESCR_PRIM(struct rpc_putLights_params, value, JSON_TOK_TRUE),
	};

	/* JSON generic thingsboard.io RPC */
	static const struct json_obj_descr rpc_descr[] = {
		JSON_OBJ_DESCR_PRIM(struct rpc_putLights, method, JSON_TOK_STRING),
		JSON_OBJ_DESCR_OBJECT(struct rpc_putLights, params, rpc_descr_params)
	};

	struct rpc_putLights rx_rpc={};
    
    json_obj_parse(json, jsonLen, rpc_descr, ARRAY_SIZE(rpc_descr), &rx_rpc);
    ledState[ rx_rpc.params.ledno -1  ] = rx_rpc.params.value;

    gpio_pin_write(led_dev, led_arr[rx_rpc.params.ledno], rx_rpc.params.value ? 0 : 1);

    // Respond with the current LED state
	snprintf( payload, 50, "{\"1\":%s,\"2\":%s,\"3\":%s}", ledState[0]?"true":"false",ledState[1]?"true":"false",ledState[2]?"true":"false");
	return payload;
}

bool getLights(u32_t ledno)
{
    u32_t value;

    gpio_pin_read(led_dev, led_arr[ledno], &value);

    return value ? false : true;
}

void lights_init()
{
    led_dev = device_get_binding(LED_PORT);

    for (u32_t i = 0; i < LED_COUNT; i++) {
        gpio_pin_configure(led_dev, led_arr[i], GPIO_DIR_OUT);
        gpio_pin_write(led_dev, led_arr[i], 1);
    }
}
```

## src/RpcConf.h
```c
#ifndef __LIGHTS_H__
#define __LIGHTS__
#ifdef __cplusplus
extern "C"{
#endif

char * putLights( char *, int );
char * setServo( char * json, int jsonLen );
bool getLights(u32_t ledno);
void lights_init();

#ifdef __cplusplus
}
#endif

#endif
```

## src/SensorBase.h
```c
#include <zephyr.h>

#include <misc/printk.h>
#include <adc.h>
#include <hal/nrf_saadc.h>
#include <sensor.h>
#include <stdio.h>
#include <string.h>

/*
The Base classes and hierarchies for the various sensor
configurations that can be set on a per-device level.
*/

// Base class for all sensor types
class SensorBase {
public:
    SensorBase(){
    }
    // These functions must be overloaded by child classes
    virtual int initialise() = 0;
    virtual char * requestPayload() = 0;
    struct device * devBinding;

protected:
    int getDevBinding(){
        if( devName ){
            this->devBinding = device_get_binding( this->devName );
            if( !this->devBinding ){
                printf("Cannot get device binding for %s\n", this->devName );
                return -1;
            }
        }
        return 0;
    }
    const char * devName = nullptr;
    const char * keyName = nullptr;
    char payloadData[ 128 ];
    size_t payloadLen;
};

// Symbolises a key-channel relation
struct KeyChan{
    const char * key;
    sensor_channel channel;
};

// Sensor base that uses the Zephyr driver backend, such as the DHT11
class DriverSensor : public SensorBase {
public:
    DriverSensor( const char * _devName, KeyChan _keyChanPairs[], uint16_t _keyChanLen ){
        this->devName = _devName;
        this->keyChanPairs = _keyChanPairs;
        this->keyChanLength = _keyChanLen;
    }
    int initialise(){
        return SensorBase::getDevBinding();
    }
    char * requestPayload(){
        if( !this->devBinding ){
            // Just return if it hasn't been initialised
            return nullptr;
        }
        int r = sensor_sample_fetch( this->devBinding );
        if ( r ) {
            // This will happen often with the DHT11 due to the inadequate 
            // timing resolution
            printf("sensor_channel_get failed, returned: %d\n", r);
            return nullptr;
        }

        this->payloadData[ 0 ] = 0;
        // Get data from all required channels, append to the payload
        for( int i = 0; i < this->keyChanLength; i++ ){
            struct sensor_value sensorVal;
            r = sensor_channel_get( this->devBinding,
                                    this->keyChanPairs[ i ].channel,
                                    &sensorVal );
            if ( r ) {
                printf("sensor_channel_get failed, returned: %d\n", r);
                break;
            }
            sprintf( this->payloadData + strlen( this->payloadData ),
                     "\"%s\":\"%f\",", this->keyChanPairs[ i ].key,
                     sensor_value_to_double( &sensorVal ) );
        }
        // Remove the final comma
        this->payloadData[ strlen( this->payloadData ) - 1 ] = 0;
        return this->payloadData;
    }

private:
    KeyChan *keyChanPairs;
    uint8_t keyChanLength; 
};

// Class for devices that use the ADC such as soil moisture
template< int bufferSize >
class ADCSensor : public SensorBase {
public:
    ADCSensor( const char * _keyName,
               const char * _adcName,
               uint8_t _channelID, 
               uint16_t _aqTime,
               uint8_t _input=NRF_SAADC_INPUT_DISABLED,
               uint8_t _res=10,
               adc_gain _gain=ADC_GAIN_1_6,
               adc_reference _ref=ADC_REF_INTERNAL ){
        this->devName = _adcName;
        this->keyName = _keyName;
        size_t keyLen = strlen( _keyName );
        // Reading a 16-bit ADC value, max (unsigned) is 65536,
        // call it 6 characters to be safe. Max payload length
        // is keyLen + 6 + 1 (for separator) + 1 (null-terminator)
        this->payloadLen = 128;

        channelConfig.gain             = _gain;
        channelConfig.reference        = _ref;
        channelConfig.acquisition_time = _aqTime;
        channelConfig.channel_id       = _channelID;
        channelConfig.input_positive   = _input;

        sensorConfig.channels    = BIT( _channelID );
        sensorConfig.buffer      = dataBuffer;
        sensorConfig.buffer_size = bufferSize * sizeof( uint16_t );
        sensorConfig.resolution  = _res;

    }

    int initialise(){
        if( SensorBase::getDevBinding() ){
            return -1;
        }

        if( auto ret=adc_channel_setup( this->devBinding, &this->channelConfig ) ){
            printf( "Failed to setup channel %i; error %i",
                    this->channelConfig.channel_id, ret );
            return ret;
        }
        return 0;
    }

    uint16_t getData(){
        if( !this->devBinding ){
            printf( "Binding not set; ADC possibly not initialised\n" );
            return 0;
        }
        if ( auto ret=adc_read( this->devBinding, &this->sensorConfig ) ) {
            printf( "Failed to read ADC with code %i", ret );
            return 0;
        }
        if( ( this->sensorData = ( int16_t ) *this->dataBuffer ) < 0 ){
            this->sensorData = 0;
        }
        
        return this->sensorData;
    }

    char * requestPayload(){
        this->getData();
        size_t wrote = sprintf( this->payloadData, "\"%s\":\"%i\"",
                                this->keyName, this->sensorData );
        if( wrote + 1 > payloadLen ){
            printf( "Uh-oh, not enough room in payload buffer...\n" );
        }
        return this->payloadData;
    }


private:
    struct adc_channel_cfg channelConfig;
    struct adc_sequence sensorConfig;
    uint16_t dataBuffer[ bufferSize ];
    int16_t sensorData;
};
```

## src/btHelper.c
```c
#include "btHelper.h"

#include <zephyr.h>
#include <stdio.h>
#include <bluetooth/bluetooth.h>
#include <bluetooth/conn.h>

static bool bt_connected;

static
void bt_connect_cb(struct bt_conn *conn, u8_t err)
{
    bt_connected = true;
}

static
void bt_disconnect_cb(struct bt_conn *conn, u8_t reason)
{
    bt_connected = false;
    printf("bt disconnected (reason %u)\n", reason);
}

static
struct bt_conn_cb bt_conn_cb = {
    .connected = bt_connect_cb,
    .disconnected = bt_disconnect_cb,
};

int networkSetup(void)
{
    const char *progress_mark = "/-\\|";
    int i = 0;
    int rc;

    rc = bt_enable(NULL);
    if (rc && rc != -EALREADY) {
        printf("bluetooth init failed\n");
        return rc;
    }

    bt_conn_cb_register(&bt_conn_cb);

    printf("\nwaiting for bt connection: ");
    while (bt_connected == false) {
        k_sleep(250);
        printf("%c\b", progress_mark[i]);
        i = (i + 1) % (sizeof(progress_mark) - 1);
    }
    printf("\n");
    return 0;
}
```

## src/btHelper.h
```c
#ifndef BTHELPER_H
#define BTHELPER_H
#ifdef __cplusplus
extern "C" {
#endif


int networkSetup();

#ifdef __cplusplus
}
#endif
#endif
```

## src/config.h
```c
/*
 * Copyright (c) 2017 Intel Corporation
 *
 * SPDX-License-Identifier: Apache-2.0
 */

#ifndef __CONFIG_H__
#define __CONFIG_H__

#ifdef CONFIG_NET_CONFIG_SETTINGS
#ifdef CONFIG_NET_IPV6
#define ZEPHYR_ADDR    CONFIG_NET_CONFIG_MY_IPV6_ADDR
#define SERVER_ADDR    CONFIG_NET_CONFIG_PEER_IPV6_ADDR
#else
#define ZEPHYR_ADDR    CONFIG_NET_CONFIG_MY_IPV4_ADDR
#define SERVER_ADDR    CONFIG_NET_CONFIG_PEER_IPV4_ADDR
#endif
#else
#ifdef CONFIG_NET_IPV6
#define ZEPHYR_ADDR    "2001:db8::1"
#define SERVER_ADDR    "2001:db8::2"
#else
#define ZEPHYR_ADDR    "192.168.1.101"
#define SERVER_ADDR    "192.168.1.10"
#endif
#endif

#define MQTT_CLIENTID    "zephyr_publisher"

#ifdef CONFIG_MQTT_LIB_TLS
#define SERVER_PORT    8883
#else
#define SERVER_PORT    1883
#endif

#define APP_NET_INIT_TIMEOUT    15000
#define APP_TX_RX_TIMEOUT       1000
#define APP_CONN_TRIES      10
#define APP_TX_CONN_TRIES       APP_CONN_TRIES
#define APP_TX_CONN_TIMEOUT     20000

#endif
```

## src/devConf.cpp
```c
// #include "devConf.h"

// #define ADC_ACQUISITION_TIME    ADC_ACQ_TIME(ADC_ACQ_TIME_MICROSECONDS, 10)

// ADCSensor< 16 > ForceSensor( "WaterLevel",          // Key name
//                              CONFIG_ADC_0_NAME,     // ADC device name
//                              0,                     // Channel ID
//                              ADC_ACQUISITION_TIME,  // Aquisition time
//                              NRF_SAADC_INPUT_AIN1 );// Input ID

// ADCSensor< 16 > SoilSensor( "M", 
//                              CONFIG_ADC_0_NAME,
//                              2,
//                              ADC_ACQUISITION_TIME,
//                              NRF_SAADC_INPUT_AIN2 );

// DriverSensor dht( "DHT11", 
//                   ( KeyChan[] ){ 
//                     KeyChan{ "T", SENSOR_CHAN_AMBIENT_TEMP },
//                     KeyChan{ "H", SENSOR_CHAN_HUMIDITY }
//                   }, 2 );



// #include "lights.h"

// RpCallback setLight = {
//     callback    : &putLights2,
//     name        : "putLights"
// };


// SensorBase * sensors[] = { &ForceSensor, &SoilSensor, &dht };
// RpCallback * rpcList[]  = { &setLight };
```

## src/devConf.h
```c
#include "SensorBase.h"
#include "RpcBase.h"

/*
Device configuration file. Unique to each device type. Configures the
sensors used and the RPC callbacks required to function.
*/
#define ADC_ACQUISITION_TIME    ADC_ACQ_TIME(ADC_ACQ_TIME_MICROSECONDS, 10)

// Force sensor for use on the water-level node
ADCSensor< 16 > ForceSensor( "F",          // Key name
                             CONFIG_ADC_0_NAME,     // ADC device name
                             0,                     // Channel ID
                             ADC_ACQUISITION_TIME,  // Aquisition time
                             NRF_SAADC_INPUT_AIN1 );// Input ID

// Soil moisture sensor for use on the field-status node
ADCSensor< 16 > SoilSensor( "M", 
                             CONFIG_ADC_0_NAME,
                             2,
                             ADC_ACQUISITION_TIME,
                             NRF_SAADC_INPUT_AIN0 );

// Temp/humidity sensor for use on the field-status node
DriverSensor dht( "DHT11", 
                  ( KeyChan[] ){ 
                    KeyChan{ "T", SENSOR_CHAN_AMBIENT_TEMP },
                    KeyChan{ "H", SENSOR_CHAN_HUMIDITY }
                  }, 2 );

#include "RpcConf.h"

// Servo actuating RPC callback for use on the water-level node
RPCB( setServoCb, setServo, setServo );
// LED RPC callback
RPCB( setLight, putLights, putLights );


// Set the lists used by the main code
SensorBase * sensors[] = { &ForceSensor };
RpCallback * rpcList[] = { &setLight, &setServoCb };
```

## src/lights.c
```c
#include <zephyr.h>
#include <board.h>
#include <device.h>
#include <gpio.h>
#include "lights.h"
#include <json.h>
#include <pwm.h>
#include <nrfx_pwm.h>

#define PWM_DEV CONFIG_PWM_NRF5_SW_0_DEV_NAME

/*
 * Unlike pulse width, period is not a critical parameter for
 * motor control. 20ms is commonly used.
 */
#define PERIOD 25000//(USEC_PER_SEC / 50) * 100

/* all in micro second */
#define STEPSIZE 100
#define MINPULSEWIDTH 700
#define MAXPULSEWIDTH 2300

#define SERVO_PIN 13

#define LED_PORT LED0_GPIO_CONTROLLER
#define LED_COUNT 4

const u32_t led_arr[LED_COUNT] = {
    LED0_GPIO_PIN,
    LED1_GPIO_PIN,
    LED2_GPIO_PIN,
    LED3_GPIO_PIN
};

struct rpc_putLights {
	const char* method;
	struct rpc_putLights_params {
		int ledno;
		bool value;
	} params;
};

struct rpc_setServo {
	const char* method;
	struct rpc_setServo_params {
		int value;
	} params;
};

struct device *led_dev;

void putLights(u32_t ledno, bool state)
{
    gpio_pin_write(led_dev, led_arr[ledno], state ? 0 : 1);
}
uint8_t ledState[4] = { 0, 0, 0 };

char * setServo( char * json, int jsonLen ){
    /* Refer to zephyr/include/json.h !!! */
    static char * payload[ 50 ];
    struct device *pwm_dev = device_get_binding( PWM_DEV );
	if (!pwm_dev) {
		printf("Cannot find PWM device!\n");
		return NULL;
	}

	/* JSON RPC params for putLights */
	static const struct json_obj_descr rpc_descr_params[] = {
		JSON_OBJ_DESCR_PRIM(struct rpc_setServo_params, value, JSON_TOK_NUMBER),
	};

	/* JSON generic thingsboard.io RPC */
	static const struct json_obj_descr rpc_descr[] = {
		JSON_OBJ_DESCR_PRIM(struct rpc_setServo, method, JSON_TOK_STRING),
		JSON_OBJ_DESCR_OBJECT(struct rpc_setServo, params, rpc_descr_params)
	};

	struct rpc_setServo rx_rpc={};
    
    json_obj_parse(json, jsonLen, rpc_descr, ARRAY_SIZE(rpc_descr), &rx_rpc);

    int pulseWidth = rx_rpc.params.value;
    printf("Got value %i\n", pulseWidth );
    if ( pulseWidth < MINPULSEWIDTH )
        pulseWidth = MINPULSEWIDTH;
    else if ( pulseWidth > MAXPULSEWIDTH )
        pulseWidth = MAXPULSEWIDTH;
    printf("Setting PWM to %i %i\n", PERIOD, pulseWidth );
    if ( pwm_pin_set_usec( pwm_dev, 13, PERIOD, pulseWidth ) ) {
			printf( "Failed to set PWM\n" );
	}

	return NULL;
}

char * putLights2( char * json, int jsonLen ){
    /* Refer to zephyr/include/json.h !!! */
    static char * payload[ 50 ];

	/* JSON RPC params for putLights */
	static const struct json_obj_descr rpc_descr_params[] = {
		JSON_OBJ_DESCR_PRIM(struct rpc_putLights_params, ledno, JSON_TOK_NUMBER),
		JSON_OBJ_DESCR_PRIM(struct rpc_putLights_params, value, JSON_TOK_TRUE),
	};

	/* JSON generic thingsboard.io RPC */
	static const struct json_obj_descr rpc_descr[] = {
		JSON_OBJ_DESCR_PRIM(struct rpc_putLights, method, JSON_TOK_STRING),
		JSON_OBJ_DESCR_OBJECT(struct rpc_putLights, params, rpc_descr_params)
	};

	struct rpc_putLights rx_rpc={};
    
    json_obj_parse(json, jsonLen, rpc_descr, ARRAY_SIZE(rpc_descr), &rx_rpc);
    ledState[ rx_rpc.params.ledno -1  ] = rx_rpc.params.value;

    gpio_pin_write(led_dev, led_arr[rx_rpc.params.ledno], rx_rpc.params.value ? 0 : 1);

    
	snprintf( payload, 50, "{\"1\":%s,\"2\":%s,\"3\":%s}", ledState[0]?"true":"false",ledState[1]?"true":"false",ledState[2]?"true":"false");
	return payload;
}

bool getLights(u32_t ledno)
{
    u32_t value;

    gpio_pin_read(led_dev, led_arr[ledno], &value);

    return value ? false : true;
}

void lights_init()
{
    led_dev = device_get_binding(LED_PORT);

    for (u32_t i = 0; i < LED_COUNT; i++) {
        gpio_pin_configure(led_dev, led_arr[i], GPIO_DIR_OUT);
        gpio_pin_write(led_dev, led_arr[i], 1);
    }
}
```

## src/lights.h
```c
#ifndef __LIGHTS_H__
#define __LIGHTS__
#ifdef __cplusplus
extern "C"{
#endif

void putLights(u32_t ledno, bool state);
char * putLights2( char *, int );
char * setServo( char * json, int jsonLen );
bool getLights(u32_t ledno);
void lights_init();

#ifdef __cplusplus
}
#endif

#endif
```
